## bitbake/bbTutorial/build/conf/bblayers.conf
```bitbake
BBPATH := "${TOPDIR}"
BBFILES ?= ""

# /home/share/oss/tools/bitbake/bbTutorial/meta-two
#BBLAYERS = "/home/share/oss/tools/bitbake/bbTutorial/meta-tutorial"
BBLAYERS = "${TOPDIR}/../meta-tutorial  \
            ${TOPDIR}/../meta-two       \
            "
```

## bitbake/bbTutorial/meta-tutorial/conf/layer.conf
```bitbake
BBPATH  .= ":${LAYERDIR}"
BBFILES += "${LAYERDIR}/recipes-*/*/*.bb"

# append layer name to list of configured layers                                                       
BBFILE_COLLECTIONS += "tutorial"                                                                       
# and use name as suffix for other properties                                                          
BBFILE_PATTERN_tutorial = "^${LAYERDIR}/"                                                              
BBFILE_PRIORITY_tutorial = "5"
```

## bitbake/bbTutorial/meta-two/conf/layer.conf
```bitbake
BBPATH .= ":${LAYERDIR}"
BBFILES += "${LAYERDIR}/recipes-*/*/*.bb ${LAYERDIR}/recipes-*/*/*.bbappend"

# append layer name to list of configured layers                                                       
BBFILE_COLLECTIONS += "two"                                                                       
# and use name as suffix for other properties                                                          
BBFILE_PATTERN_two = "^${LAYERDIR}/"                                                              
BBFILE_PRIORITY_two = "5"
LAYERVERSION_two = "1"
```
